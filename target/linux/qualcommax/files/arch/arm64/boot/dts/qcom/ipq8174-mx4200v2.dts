// SPDX-License-Identifier: GPL-2.0-or-later OR MIT
/* Copyright (c) 2023, Mohammad Sayful Islam <Sayf.mohammad01@gmail.com> */

/dts-v1/;

#include "ipq8174-mx4200.dtsi"

/ {
	model = "Linksys MX4200v2";
	compatible = "linksys,mx4200v2", "qcom,ipq8074";
};

&wifi {
	status = "okay";

	qcom,ath11k-calibration-variant = "Linksys-MX4200v2";
};

/ { 
	reserved-memory {
		ramoops_region: ramoops@51100000 {
			compatible = "ramoops";
			reg = <0x0 0x51100000 0x0 0x100000>;
			no-map;
			record-size = <0x10000>;
			console-size = <0x10000>;
		};
	};
};
